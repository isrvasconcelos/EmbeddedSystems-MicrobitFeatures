## CMakeLists.txt
```
include($ENV{ZEPHYR_BASE}/cmake/app/boilerplate.cmake NO_POLICY_SCOPE)
project(NONE)

include_directories(
    "${PROJECT_BINARY_DIR}/include/generated"
    "${PROJECT_SOURCE_DIR}/include"
    )

# Generate version file
include(build.version.cmake NO_POLICY_SCOPE)

FILE(GLOB app_sources src/*.c)
target_sources(app PRIVATE ${app_sources})

# Schedule a new version file generation after every build
add_custom_command(
    TARGET app
    POST_BUILD
    COMMAND "${CMAKE_COMMAND}"
    -DPROJECT_SOURCE_DIR=${PROJECT_SOURCE_DIR}
    -DPROJECT_BINARY_DIR=${PROJECT_BINARY_DIR}
    -P ${PROJECT_SOURCE_DIR}/build.version.cmake
    )
```

## prj.conf
```kconfig
CONFIG_GPIO=y
CONFIG_MICROBIT_DISPLAY=y
CONFIG_PWM=y
CONFIG_PWM_NRF5_SW=y
CONFIG_SYS_CLOCK_TICKS_PER_SEC=250
CONFIG_SENSOR=y
CONFIG_STDOUT_CONSOLE=y

CONFIG_I2C=y
CONFIG_I2C_INIT_PRIORITY=60
CONFIG_I2C_0=y

CONFIG_I2C_GPIO=y
CONFIG_I2C_GPIO_0=y
CONFIG_I2C_GPIO_0_GPIO=y
CONFIG_I2C_GPIO_0_SCL_PIN=19
CONFIG_I2C_GPIO_0_SDA_PIN=20

CONFIG_SYS_LOG=y
CONFIG_SYS_LOG_DEFAULT_LEVEL=4
CONFIG_SYS_LOG_SHOW_COLOR=y
```

## src/main.c
```c
/*
 * Author: Israel Vasconcelos
 * Date: May/2018
 * Computing Institute - Federal University of Alagoas
 * Board: BBC Microbit
 *
 * This application brings a table-driven
 * state machine triggered by the pushbuttons A and B.
 * 
 * \brief Description:
 * State 1 - Display: Scroll a text on LED Matrix display.
 * State 2 - Accelerometer: Move a point on LED Matrix based on accel. samples.
 * State 3 - Compass: Draw a single point which always points to the north.
 * State 4 - Thermometer: Scroll the temperat. on LED Matrix in degree Celsius.
 * State 5 - Bluetooth: Transmit data through a simple bluetooth application.
 */


#include <pwm.h>
#include <gpio.h>
#include <board.h>
#include <zephyr.h>
#include <device.h>
#include <misc/printk.h>
#include <display/mb_display.h>

#include "version.h"
#include "i2c_util.h"
#include "display_acc.h"
#include "display_temp.h"
#include "display_compass.h"


/* Sensor interfaces */
static struct i2c_dev acc; /*!< Accelerometer */
static struct i2c_dev compass;  /*!< Magnetometer */

static struct device *pwm; /*!< Pushbutton */
static struct device *gpio; /*!< Pushbutton */
static struct device *temp_dev;  /*!< Termomether */


/* Sensor flags */
bool acc_enabled = false;
bool scroll_enabled = false;
bool compass_enabled = false;
bool bluetooth_enabled = false;
bool temperature_enabled = false;

#define RESET_ALL_SENSORS() ({ 		\
	acc_enabled = false; 		\
	scroll_enabled = false;		\
	compass_enabled = false; 	\
	bluetooth_enabled = false; 	\
	temperature_enabled = false; 	\
})


/* Base structures for the table-driven state machine */
typedef enum {
	Q1,
	Q2,
	Q3,
	Q4,
	Q5
} state_t;

typedef enum {
	IDLE,
	FORWARD,
	BACKWARD
} event_t;

typedef struct {
	state_t events[3];
	void (*action)(void);
} mstate_t;

static event_t current_event = IDLE;
static state_t current_state = Q1;


/* The functions below handles the flags with state machine  */
void s1_display() { /* Show some scrolling text */
	printk("1: Display text.\n");
	scroll_enabled = true;
}

void s2_accelerometer() { /* Enable the accelerometer with LED Matrix */
	printk("2: Accelerometer enabled.\n");
	acc_enabled = true;
}

void s3_compass() { /* Enable the compass and point to the north */
	printk("3: Compass enabled.\n");
	compass_enabled = true;
}

void s4_temperature() { /* Enable the thermometer and scroll the temperature */
	printk("4: Temperature enabled.\n");
	temperature_enabled = true;
}

void s5_bluetooth() { /* Enable the bluetooth and transmit some data */
	printk("5: Bluetooth enabled.\n");
	bluetooth_enabled = true;
}

mstate_t machine[] = { /* Table-driven State Machine */
	{ .events={Q1, Q2, Q5}, .action=s1_display},
	{ .events={Q2, Q3, Q1}, .action=s2_accelerometer},
	{ .events={Q3, Q4, Q2}, .action=s3_compass},
	{ .events={Q4, Q5, Q3}, .action=s4_temperature},
	{ .events={Q5, Q1, Q4}, .action=s5_bluetooth}
};


/* Pushbutton */
static void button_pressed(struct device *dev, 
			   struct gpio_callback *cb, 
			   u32_t pins)
{
	if (pins & BIT(SW0_GPIO_PIN)) {
		printk("A pressed\n");
		current_event = BACKWARD;


	} else {
		printk("B pressed\n");
		current_event = FORWARD;
	}

	RESET_ALL_SENSORS();
	current_state = machine[current_state].events[current_event];
	machine[current_state].action();
}

static void configure_buttons(void) {

	static struct gpio_callback button_cb;

	gpio = device_get_binding(SW0_GPIO_NAME);

	gpio_pin_configure(gpio, SW0_GPIO_PIN, (GPIO_DIR_IN | 
						GPIO_INT | 
						GPIO_INT_EDGE | 
						GPIO_INT_ACTIVE_LOW));

	gpio_pin_configure(gpio, SW1_GPIO_PIN, (GPIO_DIR_IN | 
						GPIO_INT | 
						GPIO_INT_EDGE | 
						GPIO_INT_ACTIVE_LOW));

	gpio_init_callback(&button_cb, button_pressed, BIT(SW0_GPIO_PIN) | 
						       BIT(SW1_GPIO_PIN));

	gpio_add_callback(gpio, &button_cb);
	pwm = device_get_binding(CONFIG_PWM_NRF5_SW_0_DEV_NAME);

	gpio_pin_enable_callback(gpio, SW0_GPIO_PIN);
	gpio_pin_enable_callback(gpio, SW1_GPIO_PIN);
}


/* Main execution */
void main(void)
{
        SYS_LOG_WRN("Firmware version: v%d.%d.%d",
                        VERSION_MAJOR, VERSION_MINOR, VERSION_BUILD);

	uint16_t delay = 100;
	uint8_t enable_reg = 0x01;
	struct mb_image pixel = {};
	struct mb_display *disp = mb_display_get();

	temp_dev = device_get_binding("TEMP_0");
	if (!temp_dev) {
		printk("error: no temp device\n");
	}

	/* Initializing and enabling magnetometer sensor */
	i2c_util_dev_init(&compass, COMPASS_DEV_ADDR, "COMPASS", 
				    COMPASS_WHO_AM_I_REG, COMPASS_TEST_VALUE);
	i2c_util_write_bytes(&compass, 0x10, &enable_reg, sizeof(enable_reg));


	/* Initializing and enabling accelerometer sensor */
	i2c_util_dev_init(&acc, ACC_DEV_ADDR, "ACC", ACC_WHO_AM_I_REG,
	                        ACC_TEST_VALUE);
	i2c_util_write_bytes(&acc, 0x2A, &enable_reg, sizeof(enable_reg));

	configure_buttons();

	while(1) {
		if(scroll_enabled) { /* Scroll a text on LED Matrix */
			delay = 330;
			char scrolling_text[15] = "ECOM042.2017.2";

			mb_display_print(disp, MB_DISPLAY_MODE_DEFAULT | 
					       MB_DISPLAY_FLAG_LOOP, 
					       K_MSEC(delay), 
					       scrolling_text);
			
			RESET_ALL_SENSORS(); /* Avoid unwanted display flush */
		} 

		if(acc_enabled) { /* Accelerometer flag is enabled */
			delay = 100;
			acc_read(acc, disp, delay);
		} 

		if(compass_enabled) { /* Compass flag is enabled */
			delay=100;
			compass_read(compass, acc, disp, delay); 
		}

		if(temperature_enabled) { /* Thermometer flag is enabled */
			delay=1000;
			temp_read(temp_dev, disp, delay); 
		}

		if(bluetooth_enabled) { /* Bluetooth flag is enabled */
			delay=500;
			mb_display_print(disp, MB_DISPLAY_MODE_SINGLE,
					 K_MSEC(delay/2), "BT");
		}

		k_sleep(delay);
	}

}
```

## include/display_acc.h
```c
#ifndef __DISPLAY_ACC_H
#define __DISPLAY_ACC_H

#include <display/mb_display.h>
#include <misc/printk.h>
#include "i2c_util.h"

#define ACC_DEV_ADDR     0x1D
#define ACC_WHO_AM_I_REG 0x0D
#define ACC_TEST_VALUE   0x5A
#define ACC_OUT_X_MSB 0x01

uint8_t acc_data[2];

void acc_read(struct i2c_dev acc, struct mb_display *disp, uint16_t delay);

#endif //__DISPLAY_ACC_H
```

## include/display_compass.h
```c
#ifndef __DISPLAY_COMPASS_H
#define __DISPLAY_COMPASS_H

#include <display/mb_display.h>
#include <misc/printk.h>
#include "i2c_util.h"
#include "display_acc.h"

#define COMPASS_DEV_ADDR     0x0e
#define COMPASS_WHO_AM_I_REG 0x07
#define COMPASS_TEST_VALUE 0xC4
#define COMPASS_OUT_X_MSB 0x01
#define COMPASS_OUT_Y_MSB 0x03
#define COMPASS_OUT_Z_MSB 0x05

uint8_t compass_x_data[2];
uint8_t compass_y_data[2];
uint8_t compass_z_data[2];

static struct mb_image arrow_north = 
	MB_IMAGE({ 0, 0, 1, 0, 0 },
		 { 0, 0, 1, 0, 0 },
		 { 0, 0, 1, 0, 0 },
		 { 0, 1, 1, 1, 0 },
		 { 0, 0, 1, 0, 0 });

static struct mb_image arrow_right = 
	MB_IMAGE({ 0, 0, 0, 0, 0 },
		 { 0, 1, 0, 0, 0 },
		 { 1, 1, 1, 1, 1 },
		 { 0, 1, 0, 0, 0 },
		 { 0, 0, 0, 0, 0 });

static struct mb_image arrow_left = 
	MB_IMAGE({ 0, 0, 0, 0, 0 },
		 { 0, 0, 0, 1, 0 },
		 { 1, 1, 1, 1, 1 },
		 { 0, 0, 0, 1, 0 },
		 { 0, 0, 0, 0, 0 });

static struct mb_image clear_display = 
	MB_IMAGE({ 0, 0, 0, 0, 0 },
		 { 0, 0, 0, 0, 0 },
		 { 0, 0, 0, 0, 0 },
		 { 0, 0, 0, 0, 0 },
		 { 0, 0, 0, 0, 0 });



void compass_read(struct i2c_dev compass, 
		  struct i2c_dev acc, 
		  struct mb_display *disp, 
		  uint16_t delay);

#endif //__DISPLAY_COMPASS_H
```

## include/display_temp.h
```c
#ifndef __DISPLAY_TEMP_H
#define __DISPLAY_TEMP_H

#include <display/mb_display.h>
#include <misc/printk.h>
#include <sensor.h>
#include <zephyr.h>
#include <stdio.h>

static struct sensor_value temp_value;
static uint8_t current_temperature;

void temp_read(struct device *temp_dev, 
	       struct mb_display *disp, 
	       uint16_t delay);

#endif //__DISPLAY_TEMP_H
```

## include/i2c_util.h
```c
#ifndef __I2C_UTIL_H
#define __I2C_UTIL_H

#include <zephyr.h>
#include <misc/printk.h>
#include <board.h>
#include <gpio.h>
#include <device.h>
#include <i2c.h>
#include <string.h>

#define SYS_LOG_DOMAIN "PROJECT"
#include <logging/sys_log.h>

#define I2C_DEVICE_NAME_LENGTH 10

struct i2c_dev {
        struct device *dev;
        char name[I2C_DEVICE_NAME_LENGTH];
        u16_t addr;
        u8_t reg_test;
        u8_t reg_test_expected_val;
};

int i2c_util_dev_init(struct i2c_dev *i2c_dev, u16_t addr, const char *name,
                        u8_t reg_test, u8_t reg_test_expected_val);
int i2c_util_write_bytes(struct i2c_dev *i2c_dev, u8_t reg, u8_t *data, u32_t num_bytes);
int i2c_util_read_bytes(struct i2c_dev *i2c_dev, u8_t reg, u8_t *data, u32_t num_bytes);
int i2c_util_test_connection(struct i2c_dev *i2c_dev);

#endif //__I2C_UTIL_H
```

## src/display_acc.c
```c
#include "display_acc.h"

void acc_read(struct i2c_dev acc, struct mb_display *disp, uint16_t delay) {
	i2c_util_read_bytes(&acc, ACC_OUT_X_MSB, acc_data, 6);
	struct mb_image pixel = {};

	if((acc_data[2] > 196 && acc_data[4] > 170)) {
		uint8_t x=0;
		uint8_t y=0;

		/* X-Offsets to position the board */
		if(acc_data[0] < 69) {
			x = acc_data[0]/10;

		} else if(acc_data[0] > 196) {
			x = (acc_data[0]-196)/10;
		} 

		/* Y-Offsets to position the board */
		if(acc_data[2] > 196) {
			y = (acc_data[2]-196)/10;
		} 

		pixel.row[y] = BIT(x);
		mb_display_image(disp, MB_DISPLAY_MODE_SINGLE,
			K_MSEC(delay), &pixel, 1);

	}
}
```

## src/display_compass.c
```c
#include "display_compass.h"

void compass_read(struct i2c_dev compass, 
		  struct i2c_dev acc, 
		  struct mb_display *disp, 
		  uint16_t delay) 
{
	delay=100;

	/* Calibration with accelerometer */
	i2c_util_read_bytes(&acc, ACC_OUT_X_MSB, acc_data, 6);

	/* Device positioning: Valid accelerometer range */
	bool position_y = acc_data[2] > 30 && acc_data[2] < 60;
	bool position_z = acc_data[4] > 180 && acc_data[4] < 210;

	if(position_y && position_z) {
		i2c_util_read_bytes(&compass, COMPASS_OUT_X_MSB, 
				     compass_x_data, sizeof(compass_z_data));

		i2c_util_read_bytes(&compass, COMPASS_OUT_Y_MSB, 
				     compass_y_data, sizeof(compass_z_data));

		i2c_util_read_bytes(&compass, COMPASS_OUT_Z_MSB, 
				     compass_z_data, sizeof(compass_z_data));

		struct mb_image arrow = clear_display;

		/* Thresholds for compass */
		if(compass_z_data[1] < 100) 
			arrow = arrow_left;

		else if(compass_z_data[1] > 200) 
			arrow = arrow_right;

		else if(compass_z_data[1] > 101 && compass_z_data[1] < 199)
			arrow = arrow_north;

		else
			arrow = clear_display;

		/* Display on LED Matrix */
		mb_display_image(disp, MB_DISPLAY_MODE_SINGLE, 
			K_MSEC(delay), &arrow, 1);


	/* Device positioning: Offset for adjust accelerometer range */
	} else if(acc_data[2] < 60 && acc_data[4] > 180) { 

		struct mb_image pixel = {};
		uint8_t x=0;
		uint8_t y=0;

		/* X-Offsets to position the board */
		if(acc_data[0] > 20 && acc_data[0] < 50)
			x = acc_data[0]/10;

		else if(acc_data[0] > 220 && acc_data[0] < 250)
			x = (acc_data[0]-220)/10;

		/* Y-Offsets to position the board */
		y = acc_data[2]/10; 
		if(y > 3 || y == 2)
			y=y-1;

		/* Display on LED Matrix */
		pixel.row[y] = BIT(x);
		mb_display_image(disp, MB_DISPLAY_MODE_SINGLE,
			K_MSEC(delay), &pixel, 1);
	}
}
```

## src/display_temp.c
```c
#include "display_temp.h"

void temp_read(struct device *temp_dev, 
	       struct mb_display *disp, 
	       uint16_t delay) 
{
	int r;
	r = sensor_sample_fetch(temp_dev);

	if (r) {
		printf("sensor_sample_fetch failed return: %d\n", r);
	}

	r = sensor_channel_get(temp_dev, SENSOR_CHAN_TEMP,
			       &temp_value);
	if (r) {
		printf("sensor_channel_get failed return: %d\n", r);
	}

	current_temperature = sensor_value_to_double(&temp_value);
	printf("Temperature is %dC\n", current_temperature);

	char scrolling_text[4];
	snprintk(scrolling_text, 4, "%02dC", current_temperature);

//	mb_display_print(disp, MB_DISPLAY_MODE_DEFAULT | MB_DISPLAY_FLAG_LOOP, 
//		K_MSEC(delay/4), scrolling_text);

			mb_display_print(disp, MB_DISPLAY_MODE_SINGLE,
					 K_MSEC(delay/4), scrolling_text);
}
```

## src/i2c_util.c
```c
#include "i2c_util.h"

int i2c_util_dev_init(struct i2c_dev *i2c_dev, u16_t addr, const char *name,
                        u8_t reg_test, u8_t reg_test_expected_val)
{
        i2c_dev->addr = addr;
        strcpy(i2c_dev->name, name);
        i2c_dev->reg_test = reg_test;
        i2c_dev->reg_test_expected_val = reg_test_expected_val;

        int ret;
        i2c_dev->dev = device_get_binding(CONFIG_I2C_GPIO_0_NAME);
        if (!i2c_dev->dev) {
            printk("I2C: Device driver not found.\n");
            return 1;
        }

        ret = i2c_configure(i2c_dev->dev, I2C_SPEED_SET(I2C_SPEED_STANDARD) |
                                I2C_MODE_MASTER);
        if(ret) {
            SYS_LOG_ERR("Could not configure I2C device. Erro code: %d", ret);
            goto ret_err;
        }
        SYS_LOG_INF("device %s Configured successfuly.", i2c_dev->name);

        u8_t id = 0;
        ret = i2c_util_read_bytes(i2c_dev, i2c_dev->reg_test, &id, 1);
        if (ret) {
            SYS_LOG_WRN("Could not comunicate with %s. Error Code %d",
                        i2c_dev->name, ret);
            goto ret_err;
        }

        if (id == i2c_dev->reg_test_expected_val) {
                SYS_LOG_DBG("I2C test Success. Read value: 0x%X!", id);
        }
        else {
                SYS_LOG_WRN("I2C test Fail. Read value: 0x%X | Expected \
                                value: 0x%X", id,
                                i2c_dev->reg_test_expected_val);
                goto ret_err;
        }

ret_err:
        return ret;
}

int i2c_util_write_bytes(struct i2c_dev *i2c_dev, u8_t reg, u8_t *data, u32_t num_bytes)
{
        struct i2c_msg msgs[2];

        /* Send the address to read from */

        msgs[0].buf = &reg;
        msgs[0].len = 1;
        msgs[0].flags = I2C_MSG_WRITE;

        /* Read from device. STOP after this. */
        msgs[1].buf = data;
        msgs[1].len = num_bytes;
        msgs[1].flags = I2C_MSG_WRITE | I2C_MSG_STOP;

        return i2c_transfer(i2c_dev->dev, &msgs[0], 2, i2c_dev->addr);
}

int i2c_util_read_bytes(struct i2c_dev *i2c_dev, u8_t reg, u8_t *data, u32_t num_bytes)
{
        struct i2c_msg msgs[2];

        /* Send the address to read from */

        msgs[0].buf = &reg;
        msgs[0].len = 1;
        msgs[0].flags = I2C_MSG_WRITE;

        /* Read from device. STOP after this. */
        msgs[1].buf = data;
        msgs[1].len = num_bytes;
        msgs[1].flags = I2C_MSG_READ | I2C_MSG_STOP;

        return i2c_transfer(i2c_dev->dev, msgs, 2, i2c_dev->addr);
}

int i2c_util_test_connection(struct i2c_dev *i2c_dev)
{
        int ret;
        u8_t id = 0;
        ret = i2c_util_read_bytes(i2c_dev, i2c_dev->reg_test, &id, 1);
        if (ret) {
            SYS_LOG_WRN("Could not comunicate with %s. Error Code %d",
                        i2c_dev->name, ret);
            goto ret_err;
        }

        if (id == i2c_dev->reg_test_expected_val) {
                SYS_LOG_DBG("I2C test Success. Read value: 0x%X!", id);
        }
        else {
                SYS_LOG_WRN("I2C test Fail. Read value: 0x%X | Expected \
                                value: 0x%X", id,
                                i2c_dev->reg_test_expected_val);
                goto ret_err;
        }

ret_err:
        return ret;
}
```
